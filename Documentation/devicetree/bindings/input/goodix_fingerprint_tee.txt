## Documentation/devicetree/bindings/input/goodix_fingerprint_tee.txt
```
Goodix Fingerprint TEE driver

Required properties:

-compatible	: should be "goodix,fingerprint".
-interrupt-parent : gpio interrupt parent declare
-fp-gpio-irq : irq gpio declare
-fp-gpio-reset : reset gpio declare
-fp-gpio-power-on : power on gpio declare

Example:

goodix_fp {
	compatible = "goodix,fingerprint";
	interrupt-parent = <&tlmm>;
	fp-gpio-irq = <&tlmm 58 0x00>;
	fp-gpio-reset = <&tlmm 59 0x00>;
	fp-gpio-power-on = <&tlmm 65 0x00>;
	status = "okay";
};
```

## fs/crypto/Kconfig
```kconfig
config FS_ENCRYPTION
	tristate "FS Encryption (Per-file encryption)"
	select CRYPTO
	select CRYPTO_AES
	select CRYPTO_CBC
	select CRYPTO_ECB
	select CRYPTO_XTS
	select CRYPTO_CTS
	select CRYPTO_CTR
	select CRYPTO_SHA256
	select CRYPTO_SHA512
	select CRYPTO_HMAC
	select KEYS
	help
	  Enable encryption of files and directories.  This
	  feature is similar to ecryptfs, but it is more memory
	  efficient since it avoids caching the encrypted and
	  decrypted pages in the page cache.
```
