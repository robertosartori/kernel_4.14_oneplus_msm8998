/* Copyright (c) 2018, AngeloGioacchino Del Regno <kholk11@gmail.com>
 *
 * This program is free software; you can redistribute it and/or modify
 * it under the terms of the GNU General Public License version 2 and
 * only version 2 as published by the Free Software Foundation.
 *
 * This program is distributed in the hope that it will be useful,
 * but WITHOUT ANY WARRANTY; without even the implied warranty of
 * MERCHANTABILITY or FITNESS FOR A PARTICULAR PURPOSE.  See the
 * GNU General Public License for more details.
 */
&sde_dsi_samsung_s6e3fa5_1080p_cmd {
	qcom,platform-te-gpio = <&tlmm 11 0>;
	qcom,platform-reset-gpio = <&tlmm 94 0>;
	qcom,panel-supply-entries = <&dsi_panel_pwr_supply>;
	qcom,panel-vspvsn-supply-entries = <&dsi_panel_vspvsn_pwr_supply>;
	qcom,mdss-dsi-display-timings {
		1080p60 {
			qcom,display-topology = <1 0 1>;
			qcom,default-topology-index = <0>;
		};
	};
};

&sde_dsi_yoshino_panels {
	/* Default panel */
	qcom,dsi-panel = <&sde_dsi_samsung_s6e3fa5_1080p_cmd>;
};

